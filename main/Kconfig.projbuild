## main/Kconfig.projbuild
```kconfig
menu "PV-Monitor"

    config PVMON_WIFI_SSID
        string "WLAN-Name (SSID)"
        default ""

    config PVMON_WIFI_PASS
        string "WLAN-Passwort"
        default ""

    config PVMON_INVERTER_LIMIT_W
        int "Wechselrichter-Limit in Watt"
        default 800
        help
            Maximale Ausgangsleistung. Skaliert die Balkenanzeige und
            bestimmt, wie viel Reserve noch angezeigt wird.

    config PVMON_POLL_INTERVAL_MS
        int "Abfrageintervall in Millisekunden"
        default 2000
        range 500 60000

    menu "Stufe 1: Erzeugung (Shelly Plug)"
        config PVMON_PLUG_HOST
            string "IP oder Hostname des Plugs (leer = automatisch suchen)"
            default ""
            help
                Bleibt das Feld leer, sucht der Monitor per mDNS selbst
                nach Shelly-Geraeten im Netz und erkennt am Antwortverhalten,
                welches der Plug ist.
    endmenu

    config PVMON_SHOT_ENABLE
        bool "Bildschirmaufnahmen ueber HTTP anbieten"
        default n
        help
            Stellt /shot und /page bereit, um saubere Abbildungen fuer
            Dokumentation zu erzeugen, statt das Display abzufotografieren.
            Nur lesend, aber im Zweifel ausgeschaltet lassen.

    menu "Stufe 3: Speicher ueber Home Assistant"
        config PVMON_HA_ENABLE
            bool "Home Assistant einbinden"
            default n

        config PVMON_HA_HOST
            string "Adresse samt Port, etwa 192.168.1.197:8123"
            default ""
            depends on PVMON_HA_ENABLE

        config PVMON_HA_TOKEN
            string "Long-Lived Access Token"
            default ""
            depends on PVMON_HA_ENABLE
            help
                In Home Assistant unter Profil, Reiter Sicherheit, ganz unten
                anlegen. Der Token wird mit einkompiliert, das fertige Abbild
                darf deshalb nicht weitergegeben werden.

        config PVMON_HA_ENTITY_SOC
            string "Entitaet des Ladezustands in Prozent"
            default ""
            depends on PVMON_HA_ENABLE

        config PVMON_HA_ENTITY_POWER
            string "Entitaet der Speicherleistung in Watt (optional)"
            default ""
            depends on PVMON_HA_ENABLE
            help
                Zeigt an, ob der Speicher gerade laedt oder entlaedt.
                Bleibt das Feld leer, wird die Richtung ersatzweise aus der
                Veraenderung des Ladezustands abgeleitet, was traeger ist.

        config PVMON_HA_POWER_INVERT
            bool "Vorzeichen der Speicherleistung umkehren"
            default n
            depends on PVMON_HA_ENABLE
            help
                Erwartet wird: positiv bedeutet laden. Meldet der Sensor es
                andersherum, hier einschalten.

        config PVMON_HA_ENTITY_CAPACITY
            string "Entitaet der Speicherkapazitaet in kWh (optional)"
            default ""
            depends on PVMON_HA_ENABLE
            help
                Viele Speicher melden ihre Kapazitaet selbst, etwa als
                "Rated capacity". Ist das Feld gesetzt, wird der Wert von
                dort gelesen und der feste Wert unten nur als Rueckfall
                benutzt.

        config PVMON_HA_CAPACITY_WH
            int "Nennkapazitaet des Speichers in Wh (Rueckfall)"
            default 2000
            depends on PVMON_HA_ENABLE
            help
                Wird gebraucht, um aus Prozent eine Energiemenge zu machen.
                Steht meist als "Rated capacity" in den Geraetedaten.

        config PVMON_HA_RESERVE_PCT
            int "Nicht nutzbarer Sockel in Prozent"
            default 0
            range 0 90
            depends on PVMON_HA_ENABLE
            help
                Nur setzen, wenn der Speicher unterhalb eines Ladezustands
                tatsaechlich nichts mehr abgibt und der gemeldete Wert diesen
                Sockel mitzaehlt. Im Zweifel bei 0 lassen: Ein zu hoher Wert
                zeigt dauerhaft zu wenig Vorrat an.
    endmenu

    menu "Stufe 2: Netzbilanz (Shelly Pro 3EM)"
        config PVMON_EM_ENABLE
            bool "Energiezaehler einbinden"
            default n

        config PVMON_STORAGE_BETWEEN
            bool "Zwischen Plug und Netz sitzt ein Speicher"
            default n
            depends on PVMON_EM_ENABLE
            help
                Sitzt ein Batteriespeicher zwischen dem gemessenen
                Wechselrichter und dem Netzuebergabepunkt, laesst sich der
                Hausverbrauch nicht mehr aus Erzeugung und Netzbezug
                errechnen -- der Speicher puffert dazwischen, und
                Ladeleistung und Verbrauch sind nicht zu trennen.
                Dann wird statt des Hausverbrauchs angezeigt, ob die
                Anlage das Haus gerade traegt.

        config PVMON_EM_HOST
            string "IP oder Hostname des Zaehlers (leer = automatisch suchen)"
            default ""
            depends on PVMON_EM_ENABLE
    endmenu

endmenu
```
